// SPDX-License-Identifier: GPL-2.0+ OR MIT
/*
 * J715 DART resources observed in macOS 27.2.1 (26B131) IODeviceTree.
 * Resource draft only: all nodes stay disabled and this file is not
 * included by the production board tree. Power domains and locked-root
 * handling still need validation. Unpatched 7.1.9 does not implement
 * apple,remap-streams. Patch 0005 adds unlocked-DART static remaps but does
 * not establish safe power sequencing or support for locked camera roots.
 * No firmware physical addresses or guessed ISP mailbox offsets are added.
 */

&{/soc} {
	isp_j715_dart0: iommu@48e8c0000 {
		compatible = "apple,t8132-dart", "apple,t8110-dart";
		reg = <0x4 0x8e8c0000 0x0 0xc000>,
		      <0x4 0x8e8d0000 0x0 0x4000>;
		reg-names = "dart", "dapf";
		#iommu-cells = <1>;
		interrupt-parent = <&aic>;
		interrupts = <AIC_IRQ 387 IRQ_TYPE_LEVEL_HIGH>;
		apple,remap-streams = <1 0>, <2 0>, <3 0>, <6 0>,
				      <7 0>, <10 0>, <11 0>;
		status = "disabled";
	};

	isp_j715_dart1: iommu@48e8e0000 {
		compatible = "apple,t8132-dart", "apple,t8110-dart";
		reg = <0x4 0x8e8e0000 0x0 0xc000>;
		#iommu-cells = <1>;
		interrupt-parent = <&aic>;
		interrupts = <AIC_IRQ 387 IRQ_TYPE_LEVEL_HIGH>;
		apple,remap-streams = <1 0>, <2 0>, <3 0>, <6 0>,
				      <7 0>, <10 0>, <11 0>;
		status = "disabled";
	};

	isp_j715_dart2: iommu@48e900000 {
		compatible = "apple,t8132-dart", "apple,t8110-dart";
		reg = <0x4 0x8e900000 0x0 0xc000>;
		#iommu-cells = <1>;
		interrupt-parent = <&aic>;
		interrupts = <AIC_IRQ 387 IRQ_TYPE_LEVEL_HIGH>;
		apple,remap-streams = <1 0>, <2 0>, <3 0>, <6 0>,
				      <7 0>, <10 0>, <11 0>;
		status = "disabled";
	};
};
